/dts-v1/;
/plugin/;

/ {
	compatible = "xunlong,orangepi-zero", "allwinner,sun8i-h3", "allwinner,sun8i-h2-plus";

	fragment@0 {
		target = <&ehci0>;
		__overlay__ {
			status = "disabled";
		};
	};

	fragment@1 {
		target = <&ohci0>;
		 __overlay__ {
			status = "okay";
		};
	};

	fragment@2 {
		target = <&usbphy>;
		__overlay__ {
			status = "okay";
		};
	};
};
